// T32 Thu Sep 17 16:42:13 2015

 B::
 
 TOOLBAR ON
 STATUSBAR ON
 CMDPOS 273.86 6.4615 174. 12.
 WinPAGE.RESet
 
 WinPAGE.Create P000
 WinCLEAR
 
 WinPOS 341.71 15.462 80. 25. 24. 1. W003
 WinTABS 10. 10. 25. 62.
 List e:start_kernel
 
 WinPOS 448.86 1.0769 91. 12. 0. 0. W004
 AREA
 
 WinPOS 405.43 16.0 114. 26. 0. 1. W000
 WinTABS 26. 26.
 sYmbol.Browse
 
 WinPOS 272.86 16.769 115. 40. 24. 1. W005
 WinTABS 10. 10. 25. 62.
 List.auto
 
 WinPOS 410.86 27.769 80. 25. 5. 0. W006
 FRAME.VIEW 
 
 WinPOS 404.86 45.923 114. 7. 42. 1. W002
 WinTABS 13. 0. 0. 0. 0. 0. 0. 0.
 Break.List
 
 WinPOS 409.0 16.769 30. 6. 0. 0. W007
 core.SHOWACTIVE 
 
 WinPOS 371.71 2.7692 98. 81. 0. 0. W001
 CD.PEDIT /home/marc/work/SAVE/trace32/juno.cmm
 
 WinPAGE.select P000
 
 ENDDO
