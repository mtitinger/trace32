// t32 Thu Sep 17 12:04:53 2015

 B::
 
 SYMBOL.SPATH.RESET
 SYMBOL.SPATH.SET "/home/marc/work/GITS/linux"
 
 ENDDO
