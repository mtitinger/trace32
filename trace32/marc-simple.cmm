
SYStem.RESet
SYStem.CPU CORTEXA57A53

SYStem.CONFIG CORENUMBER 8.

;  CORE.ASSIGN BIGLITTLE 1. 2. NONE NONE NONE NONE NONE NONE
;  CORE.ASSIGN BIGLITTLE 1. 2. 3. NONE NONE NONE NONE NONE
    
CORE.ASSIGN 2. 4. 6. 8. 1. 3.

; Access port numbers are
SYStem.CONFIG APBACCESSPORT 1.
SYStem.CONFIG DEBUGACCESSPORT 1.
SYStem.CONFIG AXIACCESSPORT 0.
SYStem.CONFIG MEMORYACCESSPORT 0.

; Pre/Post settings
SYStem.CONFIG DAPIRPRE 4.
SYStem.CONFIG DAPDRPRE 1.
SYStem.CONFIG DAPIRPOST 0.
SYStem.CONFIG DAPDRPOST 0.

; Assignment: big_1 LITTLE_1 big_2 LITTLE_2 etc. Non-existing cores get a 
; dummy value
SYStem.CONFIG COREDEBUG BASE DAP:0x22010000 DAP:0x23010000 DAP:0x22110000 DAP:0x23110000 DAP:0x00000000 DAP:0x23210000 DAP:0x00000000 DAP:0x23310000
SYStem.CONFIG CTI BASE DAP:0x22020000 DAP:0x23020000 DAP:0x22120000 DAP:0x23120000 DAP:0x00000000 DAP:0x23220000 DAP:0x00000000 DAP:0x23320000
SYStem.CONFIG BMC BASE DAP:0x22030000 DAP:0x23030000 DAP:0x22130000 DAP:0x23130000 DAP:0x00000000 DAP:0x23230000 DAP:0x00000000 DAP:0x23330000
SYStem.CONFIG ETM BASE DAP:0x22040000 DAP:0x23040000 DAP:0x22140000 DAP:0x23140000 DAP:0x00000000 DAP:0x23240000 DAP:0x00000000 DAP:0x23340000

; FUNNEL1: Funnel main
; FUNNEL2: Cortex-A57 funnel
; FUNNEL3: Cortex-A53 funnel
SYStem.CONFIG FUNNEL1 Base DAP:0x20040000
SYStem.CONFIG FUNNEL2 Base DAP:0x220C0000
SYStem.CONFIG FUNNEL3 Base DAP:0x230C0000
SYStem.CONFIG ETF     Base DAP:0x20010000
SYStem.CONFIG TPIU    Base DAP:0x20030000
SYStem.CONFIG ETR     Base DAP:0x20070000

SYStem.CONFIG FUNNEL1 ATBSource FUNNEL2 0 FUNNEL3 1
SYStem.CONFIG FUNNEL2 ATBSource ETM.0 0 ETM.2 1
SYStem.CONFIG FUNNEL3 ATBSource ETM.1 0 ETM.3 1 ETM.5 2 ETM.7 3 
SYStem.CONFIG ETF     ATBSource FUNNEL1
SYStem.CONFIG TPIU    ATBSource ETF
SYStem.CONFIG ETR     ATBSource ETF

; Disable interrupts in debug mode.
; Set to off to debug interrupt routines
SYStem.Option IMASKASM ON
SYStem.Option IMASKHLL ON
SYStem.Option EnReset OFF               ; Avoid that reset line is pulled low
                                        ; during Prepare mode



  SYStem.Mode Prepare                             ; Prepare mode for debug access
  CORE 0.                                         ; Current core is core 0
  
  ; Poll EDLAR register until no further bus error occurs.
waitconnect:
  &connected=TRUE()                               ; Assume: next read will succeed
  &edlar=Data.Long(eapb:(corebase()+0xFB0))       ; Use EDLAR to check connection.
  IF !&connected                                  ; EDLAR should also be available
  (                                               ; even when a lock is active
    WAIT 0.5s
    GOTO waitconnect
  )

  ; Finally attach to the target
  SYStem.Mode Attach
    
    Break.direct

Data.LOAD.Elf /home/marc/work/build-aarch64/vmlinux /NOCODE  /SOURCEPATH "/home/marc/work/GITS/linux"
symbol.spath /home/marc/work/GITS/linux

ENDDO

; --------------------------------------------------------------------------------
; Support handlers
ConnectHandler:

  &connected=FALSE()

RETURN

; --------------------------------------------------------------------------------
; Error handlers

powerdown:
  DIALOG.OK "Board power did not come up. Please check the power supply and if \
  the debug connector is correctly plugged"
ENDDO
